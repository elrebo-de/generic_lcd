## examples/esp32c3_ssd1306_i2c_72x40/sdkconfig.defaults
```kconfig
CONFIG_FREERTOS_HZ=250

CONFIG_LIBC_NEWLIB=y

CONFIG_MONITOR_BAUD=115200

# CONFIG_BOOTLOADER_COMPILER_OPTIMIZATION_SIZE=y
# CONFIG_BOOTLOADER_COMPILER_OPTIMIZATION_DEBUG is not set
CONFIG_BOOTLOADER_COMPILER_OPTIMIZATION_PERF=y

CONFIG_LOG_DEFAULT_LEVEL_DEBUG=y
CONFIG_LOG_DEFAULT_LEVEL=4
CONFIG_LOG_MAXIMUM_EQUALS_DEFAULT=y
CONFIG_LOG_MAXIMUM_LEVEL=4
```
